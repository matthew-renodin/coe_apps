## apps/dummy/Kconfig
```kconfig
###############################################################################
# Dummy - Kconfig
#
#
###############################################################################

menuconfig APP_DUMMY
    bool "Dummy"
    default y
    depends on LIB_SEL4 && (LIB_MUSL_C || LIB_SEL4_C) && LIB_SEL4_PLAT_SUPPORT && \
               LIB_UTILS && LIB_SEL4_SIMPLE_DEFAULT && LIB_SEL4_DEBUG && \
               LIB_SEL4_UTILS && LIB_SEL4_VKA && \
               LIB_PROCESS && LIB_INIT
    help
       Example
```

## apps/root/Kconfig
```kconfig
###############################################################################
# Root Task - Kconfig
#
#
###############################################################################

menuconfig APP_ROOT_TASK
    bool "Root Task"
    default y
    depends on LIB_SEL4 && (LIB_MUSL_C || LIB_SEL4_C) && LIB_SEL4_SIMPLE && \
               LIB_SEL4_VKA && LIB_SEL4_ALLOCMAN && LIB_SEL4_PLAT_SUPPORT && \
               LIB_UTILS && LIB_SEL4_SIMPLE_DEFAULT && LIB_SEL4_DEBUG
    help
       Initial task to run. In charge of starting other processes and distributing capabilities.
```

## apps/test_proc/Kconfig
```kconfig
###############################################################################
# Test Process - Kconfig
#
#
###############################################################################

menuconfig APP_TEST_PROC
    bool "Test Process"
    default y
    depends on LIB_SEL4 && (LIB_MUSL_C || LIB_SEL4_C) && LIB_SEL4_PLAT_SUPPORT && \
               LIB_UTILS && LIB_SEL4_SIMPLE_DEFAULT && LIB_SEL4_DEBUG && \
               LIB_SEL4_UTILS && LIB_SEL4_VKA && \
               LIB_PROCESS && LIB_INIT
    help
       A Helper process for testing the coe libs.
```

## libs/liballocate/Kconfig
```kconfig
###############################################################################
# liballocate - Kconfig
#
#
###############################################################################

config LIB_ALLOCATE
    bool "liballocate"
    depends on HAVE_LIB_SEL4 && HAVE_LIBC
    select HAVE_SEL4_LIBS
    default y
    help
        A library to manage untyped object allocation.
```

## libs/libinit/Kconfig
```kconfig
###############################################################################
# libinit - Kconfig
#
#
###############################################################################

menuconfig LIB_INIT
    bool "libinit"
    depends on HAVE_LIB_SEL4 && HAVE_LIBC && HAVE_LIB_SEL4_VKA && HAVE_LIB_SEL4_ALLOCMAN
    select HAVE_SEL4_LIBS
    default y
    help
        A library to help a process initialize.

    
config LIB_INIT_ALLOCMAN_STATIC_POOL_BYTES
    int "Number of bytes to statically allocate for allocman to bootstrap"
    default 32768
    depends on LIB_INIT
    help 
        This value sets the size of a static array to give to liballocman for it
        to bootstrap its bookkeeping.


config LIB_INIT_ALLOCMAN_DYNAMIC_POOL_BYTES
    int "Limit the size of the allocman's dynamically allocated bookkeeping data."
    default 65536
    depends on LIB_INIT
    help 
        This value sets the size of allocman's dynamically allocated space for bookkeeping.
```

## libs/liblockvka/Kconfig
```kconfig
###############################################################################
# liblockvka - Kconfig
#
#
###############################################################################

config LIB_LOCKVKA
    bool "liblockvka"
    depends on HAVE_LIB_SEL4 && HAVE_LIBC
    select HAVE_SEL4_LIBS
    default y
    help
        A library to wrap unsafe vka with a lock to ensure thread safety.
```

## libs/liblockwrapper/Kconfig
```kconfig
###############################################################################
# liblockwrapper - Kconfig
#
#
###############################################################################

config LIB_LOCK_WRAPPER
    bool "liblockwrapper"
    depends on HAVE_LIB_SEL4 && HAVE_LIBC
    select HAVE_SEL4_LIBS
    default y
    help
        A library to wrap unsafe vka with a lock to ensure thread safety.
```

## libs/libmmap/Kconfig
```kconfig
###############################################################################
# libmmap - Kconfig
#
#
###############################################################################

config LIB_MMAP
    bool "libmmap"
    depends on HAVE_LIB_SEL4 && HAVE_LIBC && HAVE_LIB_SEL4_VKA && HAVE_LIB_SEL4_ALLOCMAN
    select HAVE_SEL4_LIBS
    default y
    help
        A library to abstract away memory mapping details of the libsel4vspace and libsel4utils libraries.
```

## libs/libprocess/Kconfig
```kconfig
###############################################################################
# libprocess - Kconfig
#
#
###############################################################################

menuconfig LIB_PROCESS
    bool "libprocess"
    depends on HAVE_LIB_SEL4 && HAVE_LIBC
    select HAVE_SEL4_LIBS
    default y
    help
        A library to help manage starting, destroying, and configuring processes. 

config LIBPROCESS_MAX_STR_LEN
    int "Maximum string length"
    depends on LIB_PROCESS
    default 64
    help
        Max length for connection object names, device names, and process names

config LIB_PROCESS_DEFAULT_HEAP_SIZE_PAGES
    int "Default heap size pages"
    depends on LIB_PROCESS
    default 256
    help
        Default heap size for a child proc

config LIB_PROCESS_DEFAULT_STACK_SIZE_PAGES
    int "Default stack size pages"
    depends on LIB_PROCESS
    default 256
    help
        Default stack size for a child proc

config LIB_PROCESS_DEFAULT_PRIORITY
    int "Default priority"
    depends on LIB_PROCESS
    default 15
    help
        Default priority for a child proc

config LIB_PROCESS_DEFAULT_MAX_PRIORITY
    int "Default max priority"
    depends on LIB_PROCESS
    default 15
    help
        Default maximum controlled priority for a child proc

config LIB_PROCESS_DEFAULT_CPU_AFFINITY
    int "Default Core Affinity"
    depends on LIB_PROCESS
    default -1
    help
        Default core for a child proc, use -1 to inherit.

config LIB_PROCESS_DEFAULT_CNODE_SIZE_BITS
    int "Default cnode size bits"
    depends on LIB_PROCESS
    default 16
    help
        This number is how many capabilities can be stored in the child's root cnode.

config LIB_PROCESS_DEFAULT_GIVE_ASID_POOL
    int "Default bool deciding if an ASID pool cap is given"
    depends on LIB_PROCESS
    default 1
    help
        If you don't give an ASID pool cap to the child it cannot create valid address spaces.

config LIB_PROCESS_DEFAULT_CREATE_FAULT_EP
    int "Default determining whether a new fault endpoint is created"
    depends on LIB_PROCESS
    default 0
    help
        In debug mode this may be desirable to be false. The kernel will print a visible exception.
```

## libs/libsync/Kconfig
```kconfig
###############################################################################
# libsync - Kconfig
#
#
###############################################################################

config LIB_SYNC
    bool "libsync"
    depends on HAVE_LIB_SEL4 && HAVE_LIBC
    select HAVE_SEL4_LIBS
    default y
    help
        A library to help a process synchronize its threads.
```

## libs/libthread/Kconfig
```kconfig
###############################################################################
# libthread - Kconfig
#
#
###############################################################################

config LIB_THREAD
    bool "libthread"
    depends on HAVE_LIB_SEL4 && HAVE_LIBC && HAVE_LIB_SEL4_VKA && HAVE_LIB_SEL4_ALLOCMAN
    select HAVE_SEL4_LIBS
    default y
    help
        A library to help a create, run, and stop threads.
```
